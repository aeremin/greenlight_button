## CMakeLists.txt
```
cmake_minimum_required(VERSION 3.20.0)

# Custom boards live in <repo>/boards
list(APPEND BOARD_ROOT ${CMAKE_CURRENT_SOURCE_DIR}/../..)

find_package(Zephyr REQUIRED HINTS $ENV{ZEPHYR_BASE})
project(beacon)

target_sources(app PRIVATE
	src/flysight.c
	src/gopro.c
	src/led.c
	src/link.c
	src/main.c
)
target_sources_ifdef(CONFIG_SHELL app PRIVATE src/shell.c)
```

## prj.conf
```kconfig
CONFIG_GPIO=y
CONFIG_INPUT=y

# Central that connects to the GoPro and FlySight, both at once
CONFIG_BT=y
CONFIG_BT_CENTRAL=y
CONFIG_BT_MAX_CONN=2
# A sleeping FlySight advertises every 2.5 s; give a connection one missed advert of slack
CONFIG_BT_CREATE_CONN_TIMEOUT=6
CONFIG_BT_GATT_CLIENT=y
CONFIG_BT_GATT_AUTO_DISCOVER_CCC=y
CONFIG_BT_DEVICE_NAME="Greenlight"
# Development asserts for code coverage. One fires on a long connection event
# with the FlySight and halts the system; the controller copes without it.
CONFIG_BT_CTLR_ASSERT_DEBUG=n

# Both devices need a bonded, encrypted link. One spare bond slot lets a
# re-pairing finish before the old bond is dropped.
CONFIG_BT_SMP=y
CONFIG_BT_MAX_PAIRED=3
# The GoPro only offers legacy pairing, which Zephyr refuses by default
CONFIG_BT_SMP_SC_PAIR_ONLY=n
# Hand peers an identity key and use private addresses, like a phone. Without it
# Zephyr distributes no identity, and the GoPro won't encrypt with the bond later.
CONFIG_BT_PRIVACY=y

# Bonds and peer roles live in the storage partition
CONFIG_BT_SETTINGS=y
CONFIG_SETTINGS=y
CONFIG_FLASH=y
CONFIG_FLASH_MAP=y
CONFIG_NVS=y

CONFIG_MAIN_STACK_SIZE=2048
# Connection callbacks can drop a bond, which writes flash
CONFIG_BT_RX_STACK_SIZE=2048

# Log over SEGGER RTT: the board has no UART pads
CONFIG_LOG=y
CONFIG_USE_SEGGER_RTT=y
CONFIG_CONSOLE=y
CONFIG_RTT_CONSOLE=y
CONFIG_UART_CONSOLE=n
CONFIG_LOG_BACKEND_RTT=y
CONFIG_LOG_BACKEND_UART=n
```

## debug.conf
```kconfig
# Debug build: a shell on RTT with "gl" commands that act like the button.
# It polls RTT every 10 ms, so leave it out of builds that run on a coin cell:
#   west build -b radioland_beacon firmware/beacon -- -DEXTRA_CONF_FILE=debug.conf

CONFIG_SHELL=y
CONFIG_SHELL_BACKEND_RTT=y
CONFIG_SHELL_BACKEND_SERIAL=n
CONFIG_SHELL_VT100_COLORS=n

# The shell carries the logs, so the plain RTT log backend would print them twice
CONFIG_LOG_BACKEND_RTT=n

# A Black Magic Probe older than v2.1 halts the CPU for each RTT poll on nRF52,
# which makes radio events start late. Skip those events instead of halting.
CONFIG_BT_CTLR_ADVANCED_FEATURES=y

# Let "gl scan" see Bluetooth 5 extended advertising too
CONFIG_BT_EXT_ADV=y

# Pairing and encryption details, with room to buffer them between slow RTT polls
CONFIG_BT_SMP_LOG_LEVEL_DBG=y
CONFIG_BT_KEYS_LOG_LEVEL_DBG=y
CONFIG_SEGGER_RTT_BUFFER_SIZE_UP=4096
CONFIG_BT_CTLR_ASSERT_OVERHEAD_START=n
```

## src/main.c
```c
#include <zephyr/bluetooth/bluetooth.h>
#include <zephyr/input/input.h>
#include <zephyr/kernel.h>
#include <zephyr/logging/log.h>
#include <zephyr/settings/settings.h>

#include "action.h"
#include "led.h"
#include "link.h"

LOG_MODULE_REGISTER(beacon, LOG_LEVEL_INF);

/* Shorter presses start, longer ones stop */
#define LONG_PRESS_MS    1000
/* Holding this long enters pairing mode without waiting for the release */
#define PAIRING_PRESS_MS 10000

#define PEER_STACK_SIZE 2048
#define PEER_PRIORITY   K_PRIO_PREEMPT(5)

static const char *const action_names[] = {
	[ACTION_START] = "Start",
	[ACTION_STOP] = "Stop",
	[ACTION_PAIR] = "Pairing",
};

static int (*const runners[PEER_COUNT])(enum action action) = {
	[PEER_GOPRO] = gopro_run,
	[PEER_FLYSIGHT] = flysight_run,
};

/* Holds only the latest request */
K_MSGQ_DEFINE(requests, sizeof(enum action), 1, 4);

K_THREAD_STACK_ARRAY_DEFINE(peer_stacks, PEER_COUNT, PEER_STACK_SIZE);
static struct k_thread peer_threads[PEER_COUNT];
static int results[PEER_COUNT];

static int64_t pressed_at;
static bool press_used;
static atomic_t pairing;

static void request(enum action action)
{
	/* The newest press wins over anything queued or running. Abort first, so the new action
	 * isn't cut short if main picks it up straight away.
	 */
	link_abort();
	k_msgq_purge(&requests);
	k_msgq_put(&requests, &action, K_NO_WAIT);
}

static void hold_handler(struct k_work *work)
{
	int64_t held = k_uptime_get() - pressed_at;

	if (held < PAIRING_PRESS_MS) {
		/* Releasing from here on is a long press */
		led_set(LED_OFF);
		k_work_reschedule(k_work_delayable_from_work(work),
				  K_MSEC(PAIRING_PRESS_MS - held));
		return;
	}

	press_used = true;
	request(ACTION_PAIR);
}

static K_WORK_DELAYABLE_DEFINE(hold_work, hold_handler);

static void on_input(struct input_event *evt, void *user_data)
{
	/* The jig button works like the on-board one */
	if (evt->type != INPUT_EV_KEY || (evt->code != INPUT_KEY_0 && evt->code != INPUT_KEY_1)) {
		return;
	}

	LOG_INF("Button %d %s", evt->code == INPUT_KEY_0 ? 0 : 1,
		evt->value ? "pressed" : "released");

	if (evt->value) {
		pressed_at = k_uptime_get();
		press_used = false;
		led_set(LED_ON);
		k_work_reschedule(&hold_work, K_MSEC(LONG_PRESS_MS));
		return;
	}

	k_work_cancel_delayable(&hold_work);
	if (!press_used) {
		button_press(k_uptime_get() - pressed_at);
	}
}

INPUT_CALLBACK_DEFINE(NULL, on_input, NULL);

void button_press(uint32_t held_ms)
{
	LOG_INF("Press held %u ms", held_ms);

	if (held_ms >= PAIRING_PRESS_MS) {
		request(ACTION_PAIR);
	} else if (atomic_get(&pairing)) {
		/* A press only ends pairing mode */
		link_abort();
	} else {
		request(held_ms < LONG_PRESS_MS ? ACTION_START : ACTION_STOP);
	}
}

static void peer_main(void *peer, void *action, void *unused)
{
	int err = runners[(uintptr_t)peer]((enum action)(uintptr_t)action);

	results[(uintptr_t)peer] = err;

	/* Each device pairs on its own, so confirm each one as it happens */
	if ((uintptr_t)action == ACTION_PAIR && !err) {
		led_flash(LED_FLASH_OK);
	}
}

static void run(enum action action)
{
	int ok = 0, failed = 0;

	LOG_INF("%s", action_names[action]);

	link_clear_abort();
	atomic_set(&pairing, action == ACTION_PAIR);
	led_set(action == ACTION_PAIR ? LED_PAIRING : LED_BUSY);

	/* Both devices at once: each takes seconds to wake */
	for (int i = 0; i < PEER_COUNT; i++) {
		k_thread_create(&peer_threads[i], peer_stacks[i], K_THREAD_STACK_SIZEOF(peer_stacks[i]),
				peer_main, (void *)(uintptr_t)i, (void *)(uintptr_t)action, NULL,
				PEER_PRIORITY, 0, K_NO_WAIT);
	}
	for (int i = 0; i < PEER_COUNT; i++) {
		k_thread_join(&peer_threads[i], K_FOREVER);
	}

	atomic_set(&pairing, 0);
	led_set(LED_OFF);

	/* A newer press cut this one short and takes over the LED */
	if (k_msgq_num_used_get(&requests) > 0) {
		return;
	}

	for (int i = 0; i < PEER_COUNT; i++) {
		if (results[i] == 0) {
			ok++;
		} else if (results[i] != -ENOENT) {
			failed++;
		}
	}

	LOG_INF("%s done: %d ok, %d failed", action_names[action], ok, failed);

	if (action == ACTION_PAIR) {
		if (ok == 0) {
			led_flash(LED_FLASH_FAIL);
		}
	} else {
		led_flash(ok > 0 && failed == 0 ? LED_FLASH_OK : LED_FLASH_FAIL);
	}
}

int main(void)
{
	enum action action;
	int err;

	err = led_init();
	if (err) {
		LOG_ERR("LED init failed (%d)", err);
	}

	err = bt_enable(NULL);
	if (err) {
		LOG_ERR("Bluetooth init failed (%d)", err);
		return 0;
	}

	err = settings_load();
	if (err) {
		LOG_ERR("Loading settings failed (%d)", err);
	}

	err = link_init();
	if (err) {
		LOG_ERR("Link init failed (%d)", err);
		return 0;
	}

	LOG_INF("Ready. GoPro %s, FlySight %s",
		link_is_paired(PEER_GOPRO) ? "paired" : "not paired",
		link_is_paired(PEER_FLYSIGHT) ? "paired" : "not paired");

	/* One flash to show the firmware is alive */
	led_flash(LED_FLASH_OK);

	for (;;) {
		/* Fails with -ENOMSG when request() purges the queue under us */
		if (k_msgq_get(&requests, &action, K_FOREVER) == 0) {
			run(action);
		}
	}

	return 0;
}
```

## src/action.h
```c
#ifndef ACTION_H_
#define ACTION_H_

#include <zephyr/kernel.h>

enum action {
	/* GoPro records video, FlySight logs a GPS track */
	ACTION_START,
	/* Both stop recording and go to sleep */
	ACTION_STOP,
	/* Bond with devices that are in pairing mode */
	ACTION_PAIR,
};

/* How long a start or stop waits for a device to show up */
#define CONNECT_TIMEOUT K_SECONDS(30)
/* How long pairing mode lasts */
#define PAIRING_TIMEOUT K_SECONDS(60)

/* Each returns 0 on success, or -ENOENT if the device was never paired. */
int gopro_run(enum action action);
int flysight_run(enum action action);

/* Act as if the button was released after being held this long. */
void button_press(uint32_t held_ms);

#endif /* ACTION_H_ */
```

## src/flysight.c
```c
/*
 * FlySight 2 through its Device State service, which needs firmware v2026.05.13.develop or
 * later. A paired FlySight advertises slowly while it sleeps and accepts mode requests then.
 */

#include <errno.h>

#include <zephyr/bluetooth/uuid.h>
#include <zephyr/logging/log.h>

#include "action.h"
#include "link.h"

LOG_MODULE_REGISTER(flysight, LOG_LEVEL_INF);

#define FLYSIGHT_UUID(n) BT_UUID_128_ENCODE(n, 0x8e22, 0x4541, 0x9d4c, 0x21edae82ed19)

static const struct bt_uuid_128 mode_uuid = BT_UUID_INIT_128(FLYSIGHT_UUID(0x00000005));
static const struct bt_uuid_128 control_uuid = BT_UUID_INIT_128(FLYSIGHT_UUID(0x00000007));

/* Manufacturer data: company, then 0x01 while in pairing request mode */
#define COMPANY_ID 0x09db

#define MODE_SLEEP  0x00
#define MODE_ACTIVE 0x01
#define MODE_START  0x05

#define CMD_REQUEST_SLEEP  0x10
#define CMD_REQUEST_ACTIVE 0x11

#define SETTLE_TRIES 15
#define SETTLE_MS    200

static int check_pairing(uint8_t adv_type, struct net_buf_simple *ad)
{
	uint8_t status;

	return (link_mfg_data(ad, COMPANY_ID, &status, 1) >= 1 && status == 0x01) ? 0 : 1;
}

static int read_mode(uint16_t handle)
{
	uint8_t mode;
	int n = link_read(PEER_FLYSIGHT, handle, &mode, 1);

	if (n < 0) {
		return n;
	}
	return n == 1 ? mode : -EIO;
}

static int set_mode(enum action action)
{
	uint16_t mode_handle, control_handle;
	uint8_t target, cmd;
	int mode, err;

	err = link_find(PEER_FLYSIGHT, &mode_uuid.uuid, &mode_handle);
	if (!err) {
		err = link_find(PEER_FLYSIGHT, &control_uuid.uuid, &control_handle);
	}
	if (err) {
		LOG_ERR("Device State service not found (%d); update the FlySight firmware", err);
		return err;
	}

	mode = read_mode(mode_handle);
	if (mode < 0) {
		return mode;
	}

	if (action == ACTION_START) {
		/* Start mode logs too, for the starter pistol */
		if (mode == MODE_ACTIVE || mode == MODE_START) {
			LOG_INF("Logging already");
			return 0;
		}
		/* Only sleep may move to active, so don't override config, pairing or USB */
		if (mode != MODE_SLEEP) {
			LOG_WRN("Busy in mode %d", mode);
			return -EBUSY;
		}
		target = MODE_ACTIVE;
		cmd = CMD_REQUEST_ACTIVE;
	} else {
		if (mode == MODE_SLEEP) {
			LOG_INF("Asleep already");
			return 0;
		}
		target = MODE_SLEEP;
		cmd = CMD_REQUEST_SLEEP;
	}

	/* Without indications enabled the FlySight sends no response, so poll the mode instead */
	err = link_write(PEER_FLYSIGHT, control_handle, &cmd, sizeof(cmd));
	if (err) {
		return err;
	}

	for (int i = 0; i < SETTLE_TRIES; i++) {
		err = link_sleep(SETTLE_MS);
		if (err) {
			return err;
		}
		mode = read_mode(mode_handle);
		if (mode == target) {
			LOG_INF("%s", target == MODE_ACTIVE ? "Logging" : "Asleep");
			return 0;
		}
		if (mode < 0) {
			return mode;
		}
	}

	LOG_WRN("Mode stuck at %d", mode);
	return -ETIMEDOUT;
}

int flysight_run(enum action action)
{
	bool pair = action == ACTION_PAIR;
	int err;

	err = link_connect(PEER_FLYSIGHT, pair, pair ? check_pairing : NULL,
			   pair ? PAIRING_TIMEOUT : CONNECT_TIMEOUT);
	if (err) {
		return err;
	}

	if (pair) {
		LOG_INF("Paired");
	} else {
		err = set_mode(action);
	}

	link_disconnect(PEER_FLYSIGHT);
	return err;
}
```

## src/gopro.c
```c
/*
 * GoPro over the Open GoPro BLE API. A paired camera keeps advertising for 8 hours after it
 * goes to sleep, and connecting to it in that time wakes it up.
 */

#include <errno.h>

#include <zephyr/bluetooth/uuid.h>
#include <zephyr/logging/log.h>

#include "action.h"
#include "link.h"

LOG_MODULE_REGISTER(gopro, LOG_LEVEL_INF);

#define GOPRO_UUID(n) BT_UUID_128_ENCODE(0xb5f90000 | (n), 0xaa8d, 0x11e3, 0x9046, 0x0002a5d5c51b)

static const struct bt_uuid_128 command_uuid = BT_UUID_INIT_128(GOPRO_UUID(0x0072));
static const struct bt_uuid_128 response_uuid = BT_UUID_INIT_128(GOPRO_UUID(0x0073));
static const struct bt_uuid_128 network_uuid = BT_UUID_INIT_128(GOPRO_UUID(0x0091));
static const struct bt_uuid_128 network_rsp_uuid = BT_UUID_INIT_128(GOPRO_UUID(0x0092));

/* Manufacturer data: company (GoPro's 0x02f2; its docs show the bytes in air order), schema
 * version, camera status
 */
#define COMPANY_ID     0x02f2
#define STATUS_AWAKE   BIT(0)
#define STATUS_PAIRING BIT(2)

/* Commands carry a one-byte length header, the command ID, then length-value parameters */
static const uint8_t cmd_hw_info[] = {0x01, 0x3c};
static const uint8_t cmd_shutter_on[] = {0x03, 0x01, 0x01, 0x01};
static const uint8_t cmd_shutter_off[] = {0x03, 0x01, 0x01, 0x00};
static const uint8_t cmd_sleep[] = {0x01, 0x05};

/*
 * Network management feature 0x03, action 0x01 (set pairing state) with a RequestPairingFinish
 * protobuf: result SUCCESS and a client name. It clears the pairing screen on the camera.
 */
static const uint8_t cmd_pairing_finish[] = {
	0x10, 0x03, 0x01, 0x08, 0x00, 0x12, 0x0a,
	'G', 'r', 'e', 'e', 'n', 'l', 'i', 'g', 'h', 't',
};

/* Its response: feature 0x03, action 0x81, then ResponseGeneric with result 1 (success) */
#define PAIRING_RSP_FEATURE 0x03
#define PAIRING_RSP_ACTION  0x81
#define RESULT_SUCCESS      1
/* Stay connected a little after pairing, as the camera apps do */
#define PAIRING_LINGER_MS   2000

#define RESPONSE_TIMEOUT K_SECONDS(2)
/* Covers booting from sleep and closing a video file */
#define COMMAND_TIMEOUT  K_SECONDS(20)
#define RETRY_MS         500

static uint16_t command_handle;

static int camera_status(struct net_buf_simple *ad)
{
	static int last = -1;
	uint8_t data[2];

	if (link_mfg_data(ad, COMPANY_ID, data, sizeof(data)) < (int)sizeof(data)) {
		return -ENOENT;
	}

	if (data[1] != last) {
		last = data[1];
		LOG_INF("Camera status 0x%02x (schema %u)", data[1], data[0]);
	}
	return data[1];
}

static int check_pairing(uint8_t adv_type, struct net_buf_simple *ad)
{
	int status = camera_status(ad);

	return (status >= 0 && (status & STATUS_PAIRING)) ? 0 : 1;
}

static int check_awake(uint8_t adv_type, struct net_buf_simple *ad)
{
	int status = camera_status(ad);

	/* Connecting would only wake it up to put it back to sleep */
	return (status >= 0 && !(status & STATUS_AWAKE)) ? -EALREADY : 0;
}

/*
 * Wait for the response whose first byte after the packet header is id0 and, with match_id1,
 * whose second is id1. Returns the offset of that second byte in rsp, or a negative error.
 */
static int await_response(uint8_t id0, uint8_t id1, bool match_id1, uint8_t *rsp, size_t size,
			  int *len)
{
	k_timepoint_t end = sys_timepoint_calc(RESPONSE_TIMEOUT);

	for (;;) {
		int n = link_recv(PEER_GOPRO, rsp, size, sys_timepoint_timeout(end));
		int at;

		if (n < 0) {
			return n;
		}

		/* Bit 7 marks a continuation packet. Bits 6-5 pick a 5, 13 or 16-bit length. */
		if (rsp[0] & BIT(7)) {
			continue;
		}
		at = 1 + (rsp[0] >> 5);
		if (at > 3 || n < at + 2 || rsp[at] != id0 || (match_id1 && rsp[at + 1] != id1)) {
			continue;
		}
		*len = n;
		return at + 1;
	}
}

/* Returns the command status from the response, or a negative error. */
static int command(const uint8_t *req, uint16_t len)
{
	uint8_t rsp[20];
	int at, n, err;

	link_flush(PEER_GOPRO);
	err = link_write(PEER_GOPRO, command_handle, req, len);
	if (err) {
		return err;
	}

	at = await_response(req[1], 0, false, rsp, sizeof(rsp), &n);
	return at < 0 ? at : rsp[at];
}

/* Tell the camera pairing is done, so it keeps the bond and leaves its pairing screen. */
static int finish_pairing(void)
{
	uint16_t cmd_handle, rsp_handle;
	uint8_t rsp[20];
	int at, n, err;

	err = link_find(PEER_GOPRO, &network_uuid.uuid, &cmd_handle);
	if (!err) {
		err = link_find(PEER_GOPRO, &network_rsp_uuid.uuid, &rsp_handle);
	}
	if (!err) {
		err = link_subscribe(PEER_GOPRO, rsp_handle);
	}
	if (err) {
		LOG_ERR("Network management characteristics not found (%d)", err);
		return err;
	}

	link_flush(PEER_GOPRO);
	err = link_write(PEER_GOPRO, cmd_handle, cmd_pairing_finish, sizeof(cmd_pairing_finish));
	if (err) {
		return err;
	}

	at = await_response(PAIRING_RSP_FEATURE, PAIRING_RSP_ACTION, true, rsp, sizeof(rsp), &n);
	if (at < 0) {
		LOG_WRN("No answer to pairing finish (%d)", at);
		return at;
	}

	/* After the action, protobuf field 1 (result) as a varint: tag 0x08, then the value */
	if (n < at + 3 || rsp[at + 1] != 0x08 || rsp[at + 2] != RESULT_SUCCESS) {
		LOG_WRN("Pairing finish refused (%d bytes, result %d)", n,
			n >= at + 3 ? rsp[at + 2] : -1);
		return -EIO;
	}
	LOG_INF("Camera confirmed pairing");

	return link_sleep(PAIRING_LINGER_MS);
}

/* The camera turns commands down while it boots or is busy, so keep asking. */
static int command_retry(const uint8_t *req, uint16_t len, const char *what)
{
	k_timepoint_t end = sys_timepoint_calc(COMMAND_TIMEOUT);
	int status;

	for (;;) {
		status = command(req, len);
		if (status == 0 || status == -ENOTCONN) {
			break;
		}
		if (sys_timepoint_expired(end) || link_sleep(RETRY_MS) == -ECANCELED) {
			break;
		}
	}

	if (status) {
		LOG_WRN("%s failed (%d)", what, status);
	}
	return status > 0 ? -EIO : status;
}

int gopro_run(enum action action)
{
	link_adv_check_t check = NULL;
	uint16_t response_handle;
	int err;

	if (action == ACTION_PAIR) {
		check = check_pairing;
	} else if (action == ACTION_STOP) {
		check = check_awake;
	}

	err = link_connect(PEER_GOPRO, action == ACTION_PAIR, check,
			   action == ACTION_PAIR ? PAIRING_TIMEOUT : CONNECT_TIMEOUT);
	if (err == -EALREADY) {
		LOG_INF("Asleep already");
		return 0;
	}
	if (err) {
		return err;
	}

	err = link_find(PEER_GOPRO, &command_uuid.uuid, &command_handle);
	if (!err) {
		err = link_find(PEER_GOPRO, &response_uuid.uuid, &response_handle);
	}
	if (!err) {
		err = link_subscribe(PEER_GOPRO, response_handle);
	}
	if (err) {
		LOG_ERR("Command characteristics not found (%d)", err);
		goto out;
	}

	/* Hardware info answers once the camera is ready for commands */
	err = command_retry(cmd_hw_info, sizeof(cmd_hw_info), "Waiting for camera");
	if (err) {
		goto out;
	}

	switch (action) {
	case ACTION_START:
		err = command_retry(cmd_shutter_on, sizeof(cmd_shutter_on), "Shutter on");
		if (!err) {
			LOG_INF("Recording");
		}
		break;

	case ACTION_STOP:
		err = command_retry(cmd_shutter_off, sizeof(cmd_shutter_off), "Shutter off");
		if (err) {
			break;
		}
		err = command_retry(cmd_sleep, sizeof(cmd_sleep), "Sleep");
		/* The camera may drop the link before it answers */
		if (err == -ENOTCONN) {
			err = 0;
		}
		if (!err) {
			LOG_INF("Stopped and asleep");
		}
		break;

	case ACTION_PAIR:
		err = finish_pairing();
		if (err) {
			LOG_ERR("Finishing pairing failed (%d)", err);
		} else {
			LOG_INF("Paired");
		}
		break;
	}

out:
	link_disconnect(PEER_GOPRO);
	return err;
}
```

## src/led.c
```c
#include "led.h"

#include <zephyr/drivers/gpio.h>
#include <zephyr/kernel.h>
#include <zephyr/spinlock.h>

static const struct gpio_dt_spec led = GPIO_DT_SPEC_GET(DT_ALIAS(led0), gpios);

/* Step durations in ms, alternating on and off. Without steps the LED holds level. */
struct pattern {
	const uint16_t *steps;
	uint8_t len;
	bool repeat;
	bool level;
};

#define STEPS(...) .steps = (const uint16_t[]){__VA_ARGS__}, \
		   .len = sizeof((uint16_t[]){__VA_ARGS__}) / sizeof(uint16_t)

static const struct pattern modes[] = {
	[LED_OFF] = {.level = false},
	[LED_ON] = {.level = true},
	[LED_BUSY] = {STEPS(30, 970), .repeat = true},
	[LED_PAIRING] = {STEPS(60, 140, 60, 740), .repeat = true},
};

static const struct pattern flashes[] = {
	[LED_FLASH_OK] = {STEPS(1000, 300)},
	[LED_FLASH_FAIL] = {STEPS(100, 100, 100, 100, 100, 100, 100, 100, 100, 300)},
};

static struct k_spinlock lock;
static const struct pattern *base = &modes[LED_OFF];
static const struct pattern *flash;
static const struct pattern *current = &modes[LED_OFF];
static uint8_t step_index;

static void step(struct k_work *work);
static K_WORK_DELAYABLE_DEFINE(step_work, step);

static void step(struct k_work *work)
{
	k_spinlock_key_t key = k_spin_lock(&lock);
	uint16_t delay = 0;
	bool level;

	for (;;) {
		if (step_index < current->len) {
			level = step_index % 2 == 0;
			delay = current->steps[step_index++];
			break;
		}
		if (current == flash) {
			flash = NULL;
			current = base;
		} else if (current->len > 0 && current->repeat) {
			/* Start over below */
		} else {
			level = current->level;
			break;
		}
		step_index = 0;
	}

	k_spin_unlock(&lock, key);

	gpio_pin_set_dt(&led, level);
	if (delay) {
		k_work_reschedule(&step_work, K_MSEC(delay));
	}
}

static void play(const struct pattern *pattern)
{
	current = pattern;
	step_index = 0;
	k_work_reschedule(&step_work, K_NO_WAIT);
}

int led_init(void)
{
	if (!gpio_is_ready_dt(&led)) {
		return -ENODEV;
	}
	return gpio_pin_configure_dt(&led, GPIO_OUTPUT_INACTIVE);
}

void led_set(enum led_mode mode)
{
	k_spinlock_key_t key = k_spin_lock(&lock);

	base = &modes[mode];
	if (!flash) {
		play(base);
	}

	k_spin_unlock(&lock, key);
}

void led_flash(enum led_flash which)
{
	k_spinlock_key_t key = k_spin_lock(&lock);

	flash = &flashes[which];
	play(flash);

	k_spin_unlock(&lock, key);
}
```

## src/led.h
```c
#ifndef LED_H_
#define LED_H_

enum led_mode {
	LED_OFF,
	LED_ON,
	/* Brief blink each second while a start or stop runs */
	LED_BUSY,
	/* Double blink each second in pairing mode */
	LED_PAIRING,
};

enum led_flash {
	/* One long flash */
	LED_FLASH_OK,
	/* Five quick flashes */
	LED_FLASH_FAIL,
};

int led_init(void);

/* The pattern to show when no flash is playing. */
void led_set(enum led_mode mode);

/* Play a flash once, then return to the mode. */
void led_flash(enum led_flash flash);

#endif /* LED_H_ */
```

## src/link.c
```c
#include "link.h"

#include <errno.h>
#include <string.h>

#include <zephyr/bluetooth/conn.h>
#include <zephyr/bluetooth/gatt.h>
#include <zephyr/logging/log.h>
#include <zephyr/settings/settings.h>
#include <zephyr/sys/atomic.h>
#include <zephyr/sys/byteorder.h>
#include <zephyr/sys/util.h>

LOG_MODULE_REGISTER(link, LOG_LEVEL_INF);

#define SETTINGS_ROOT "greenlight"
#define NOTIFY_MAX    20
#define NOTIFY_QUEUE  8
#define SUBSCRIPTIONS 2
#define POLL_MS       100

struct notification {
	uint8_t len;
	uint8_t data[NOTIFY_MAX];
};

/* A slot is free while params.value_handle is 0 */
struct subscription {
	struct bt_gatt_subscribe_params params;
	struct bt_gatt_discover_params discover;
	struct link *link;
};

struct link {
	const char *name;
	const char *key;
	/* Identity address of the bonded device, or BT_ADDR_LE_ANY */
	bt_addr_le_t addr;
	/* Set when pairing replaced the bonded device, until link_connect() saves the change */
	bool addr_changed;
	bt_addr_le_t replaced;

	/* While link_connect() waits for the peer */
	bool connecting;
	bool pair;
	link_adv_check_t check;

	struct bt_conn *conn;
	/* Completion of the connection or of the GATT procedure in flight, with err */
	struct k_sem done;
	int err;
	/* Given when conn is released */
	struct k_sem gone;

	struct bt_gatt_discover_params discover;
	uint16_t found;
	struct bt_gatt_read_params read;
	uint8_t *read_buf;
	uint16_t read_size;
	struct bt_gatt_write_params write;

	struct subscription subs[SUBSCRIPTIONS];
	struct k_msgq rx;
	char rx_buf[NOTIFY_QUEUE * sizeof(struct notification)];
};

static struct link links[PEER_COUNT] = {
	[PEER_GOPRO] = {.name = "GoPro", .key = "gopro"},
	[PEER_FLYSIGHT] = {.name = "FlySight", .key = "flysight"},
};

/* Guards the connection state shared with the Bluetooth callbacks */
static K_MUTEX_DEFINE(lock);
static bool scanning;
static bool initiating;
static atomic_t aborted;

static const struct bt_le_scan_param scan_param = BT_LE_SCAN_PARAM_INIT(
	BT_LE_SCAN_TYPE_PASSIVE, BT_LE_SCAN_OPT_NONE, BT_GAP_SCAN_FAST_INTERVAL,
	BT_GAP_SCAN_FAST_INTERVAL);

static bool paired(const struct link *l)
{
	return !bt_addr_le_eq(&l->addr, BT_ADDR_LE_ANY);
}

static struct link *find_link(const struct bt_conn *conn)
{
	ARRAY_FOR_EACH_PTR(links, l) {
		if (l->conn == conn) {
			return l;
		}
	}
	return NULL;
}

static struct bt_conn *get_conn(struct link *l)
{
	struct bt_conn *conn = NULL;

	k_mutex_lock(&lock, K_FOREVER);
	if (l->conn) {
		conn = bt_conn_ref(l->conn);
	}
	k_mutex_unlock(&lock);
	return conn;
}

static void device_found(const bt_addr_le_t *addr, int8_t rssi, uint8_t adv_type,
			 struct net_buf_simple *ad);

/* Scan while a peer is wanted and no connection is being created. Call with lock held. */
static void scan_update(void)
{
	bool want = false;
	int err;

	if (!initiating) {
		ARRAY_FOR_EACH_PTR(links, l) {
			want |= l->connecting && !l->conn;
		}
	}

	if (want == scanning) {
		return;
	}

	if (want) {
		err = bt_le_scan_start(&scan_param, device_found);
	} else {
		err = bt_le_scan_stop();
	}
	if (err) {
		LOG_ERR("Scan %s failed (%d)", want ? "start" : "stop", err);
		return;
	}
	scanning = want;
}

/* End link_connect() with err. Call with lock held. */
static void finish(struct link *l, int err)
{
	l->err = err;
	l->connecting = false;
	k_sem_give(&l->done);
	scan_update();
}

static void connect(struct link *l, const bt_addr_le_t *addr)
{
	char str[BT_ADDR_LE_STR_LEN];
	int err;

	bt_addr_le_to_str(addr, str, sizeof(str));
	LOG_INF("%s: connecting to %s", l->name, str);

	/* Stop scanning first, as the controller may not scan and initiate at once */
	initiating = true;
	scan_update();

	err = bt_conn_le_create(addr, BT_CONN_LE_CREATE_CONN, BT_LE_CONN_PARAM_DEFAULT, &l->conn);
	if (err) {
		LOG_WRN("%s: connection failed to start (%d)", l->name, err);
		initiating = false;
		scan_update();
	}
}

static void device_found(const bt_addr_le_t *addr, int8_t rssi, uint8_t adv_type,
			 struct net_buf_simple *ad)
{
	if (adv_type != BT_GAP_ADV_TYPE_ADV_IND && adv_type != BT_GAP_ADV_TYPE_ADV_DIRECT_IND) {
		return;
	}

	k_mutex_lock(&lock, K_FOREVER);

	/* Reports can trail a scan stop */
	if (!scanning || initiating) {
		goto out;
	}

	ARRAY_FOR_EACH_PTR(links, l) {
		struct net_buf_simple_state state;
		int res = 0;

		if (!l->connecting || l->conn) {
			continue;
		}

		if (l->pair) {
			if (!l->check) {
				continue;
			}
		} else if (!bt_addr_le_eq(addr, &l->addr)) {
			continue;
		}

		if (l->check) {
			net_buf_simple_save(ad, &state);
			res = l->check(adv_type, ad);
			net_buf_simple_restore(ad, &state);
		}

		if (res < 0) {
			finish(l, res);
		} else if (res == 0) {
			connect(l, addr);
		} else {
			continue;
		}
		break;
	}

out:
	k_mutex_unlock(&lock);
}

static void release(struct link *l)
{
	bt_conn_unref(l->conn);
	l->conn = NULL;
	k_sem_give(&l->gone);
}

static void connected(struct bt_conn *conn, uint8_t conn_err)
{
	struct link *l;
	int err;

	k_mutex_lock(&lock, K_FOREVER);

	l = find_link(conn);
	if (!l) {
		goto out;
	}

	initiating = false;

	if (conn_err) {
		LOG_WRN("%s: connection failed (0x%02x)", l->name, conn_err);
		release(l);
		scan_update();
		goto out;
	}

	LOG_INF("%s: connected", l->name);

	/* Encrypts with the bond keys, or pairs when there are none */
	err = bt_conn_set_security(conn, BT_SECURITY_L2);
	if (err) {
		LOG_WRN("%s: security request failed (%d)", l->name, err);
		bt_conn_disconnect(conn, BT_HCI_ERR_AUTH_FAIL);
	}

	scan_update();

out:
	k_mutex_unlock(&lock);
}

static void disconnected(struct bt_conn *conn, uint8_t reason)
{
	struct link *l;

	k_mutex_lock(&lock, K_FOREVER);

	l = find_link(conn);
	if (!l) {
		goto out;
	}

	LOG_INF("%s: disconnected (0x%02x)", l->name, reason);
	release(l);

	if (l->connecting) {
		/* Not up yet; try again on the next advertisement */
		scan_update();
	} else {
		/* Wake whatever GATT procedure is waiting */
		l->err = -ENOTCONN;
		k_sem_give(&l->done);
	}

out:
	k_mutex_unlock(&lock);
}

static void security_changed(struct bt_conn *conn, bt_security_t level,
			     enum bt_security_err err)
{
	struct link *l;

	k_mutex_lock(&lock, K_FOREVER);

	l = find_link(conn);
	if (!l || !l->connecting) {
		goto out;
	}

	if (err == BT_SECURITY_ERR_PIN_OR_KEY_MISSING && l->pair) {
		/* The device forgot the bond. Drop it and pair afresh on the next connection. */
		LOG_INF("%s: bond rejected, pairing again", l->name);
		if (bt_addr_le_eq(bt_conn_get_dst(conn), &l->addr)) {
			bt_addr_le_copy(&l->replaced, &l->addr);
			bt_addr_le_copy(&l->addr, BT_ADDR_LE_ANY);
			l->addr_changed = true;
		}
		bt_unpair(BT_ID_DEFAULT, bt_conn_get_dst(conn));
		goto out;
	}

	if (err == BT_SECURITY_ERR_PIN_OR_KEY_MISSING) {
		LOG_WRN("%s: bond rejected; pair it again", l->name);
		finish(l, -EACCES);
		bt_conn_disconnect(conn, BT_HCI_ERR_AUTH_FAIL);
		goto out;
	}

	if (err) {
		/* Often just a link that dropped, so try again on the next advertisement */
		LOG_WRN("%s: security failed (%d), retrying", l->name, err);
		bt_conn_disconnect(conn, BT_HCI_ERR_AUTH_FAIL);
		goto out;
	}

	/* A new bond is only complete once pairing_complete() has the keys */
	if (!l->pair || bt_addr_le_eq(bt_conn_get_dst(conn), &l->addr)) {
		LOG_INF("%s: encrypted", l->name);
		finish(l, 0);
	}

out:
	k_mutex_unlock(&lock);
}

BT_CONN_CB_DEFINE(conn_callbacks) = {
	.connected = connected,
	.disconnected = disconnected,
	.security_changed = security_changed,
};

static void pairing_complete(struct bt_conn *conn, bool bonded)
{
	struct link *l;

	k_mutex_lock(&lock, K_FOREVER);

	l = find_link(conn);
	if (!l || !l->connecting || !l->pair) {
		goto out;
	}

	if (!bonded) {
		LOG_WRN("%s: paired without bonding", l->name);
		finish(l, -EACCES);
		bt_conn_disconnect(conn, BT_HCI_ERR_AUTH_FAIL);
		goto out;
	}

	/* bt_conn_get_dst() is the identity address once the keys are exchanged */
	if (!bt_addr_le_eq(bt_conn_get_dst(conn), &l->addr)) {
		if (!l->addr_changed) {
			bt_addr_le_copy(&l->replaced, &l->addr);
		}
		bt_addr_le_copy(&l->addr, bt_conn_get_dst(conn));
		l->addr_changed = true;
	}

	LOG_INF("%s: bonded", l->name);
	finish(l, 0);

out:
	k_mutex_unlock(&lock);
}

static void pairing_failed(struct bt_conn *conn, enum bt_security_err reason)
{
	struct link *l;

	k_mutex_lock(&lock, K_FOREVER);

	l = find_link(conn);
	if (l && l->connecting && l->pair) {
		/* A dropped link fails pairing as unspecified; try again on the next advert */
		if (reason == BT_SECURITY_ERR_UNSPECIFIED) {
			LOG_WRN("%s: pairing interrupted, retrying", l->name);
		} else {
			LOG_WRN("%s: pairing failed (%d)", l->name, reason);
			finish(l, -EACCES);
		}
		bt_conn_disconnect(conn, BT_HCI_ERR_AUTH_FAIL);
	}

	k_mutex_unlock(&lock);
}

static struct bt_conn_auth_info_cb auth_info_callbacks = {
	.pairing_complete = pairing_complete,
	.pairing_failed = pairing_failed,
};

static int settings_set(const char *name, size_t len, settings_read_cb read_cb, void *cb_arg)
{
	ARRAY_FOR_EACH_PTR(links, l) {
		if (!settings_name_steq(name, l->key, NULL)) {
			continue;
		}
		if (len != sizeof(l->addr)) {
			return -EINVAL;
		}
		return MIN(read_cb(cb_arg, &l->addr, sizeof(l->addr)), 0);
	}
	return -ENOENT;
}

SETTINGS_STATIC_HANDLER_DEFINE(greenlight, SETTINGS_ROOT, NULL, settings_set, NULL, NULL);

static void save_addr(struct link *l)
{
	char key[32];
	int err;

	snprintk(key, sizeof(key), SETTINGS_ROOT "/%s", l->key);
	if (paired(l)) {
		err = settings_save_one(key, &l->addr, sizeof(l->addr));
	} else {
		err = settings_delete(key);
	}
	if (err) {
		LOG_ERR("%s: saving the bonded address failed (%d)", l->name, err);
	}
}

struct stale_bonds {
	bt_addr_le_t addr[CONFIG_BT_MAX_PAIRED];
	size_t count;
};

static void find_stale_bond(const struct bt_bond_info *info, void *user_data)
{
	struct stale_bonds *stale = user_data;

	ARRAY_FOR_EACH_PTR(links, l) {
		if (bt_addr_le_eq(&info->addr, &l->addr)) {
			return;
		}
	}
	if (stale->count < ARRAY_SIZE(stale->addr)) {
		bt_addr_le_copy(&stale->addr[stale->count++], &info->addr);
	}
}

int link_init(void)
{
	struct stale_bonds stale = {0};
	int err;

	ARRAY_FOR_EACH_PTR(links, l) {
		k_sem_init(&l->done, 0, 1);
		k_sem_init(&l->gone, 0, 1);
		k_msgq_init(&l->rx, l->rx_buf, sizeof(struct notification), NOTIFY_QUEUE);

		/* A role whose keys are gone, e.g. after a failed save, can't connect */
		if (paired(l) && !bt_le_bond_exists(BT_ID_DEFAULT, &l->addr)) {
			LOG_WRN("%s: bond missing, forgetting it", l->name);
			bt_addr_le_copy(&l->addr, BT_ADDR_LE_ANY);
			save_addr(l);
		}
	}

	/* Bonds without a role only take up room */
	bt_foreach_bond(BT_ID_DEFAULT, find_stale_bond, &stale);
	for (size_t i = 0; i < stale.count; i++) {
		bt_unpair(BT_ID_DEFAULT, &stale.addr[i]);
	}

	err = bt_conn_auth_info_cb_register(&auth_info_callbacks);
	if (err) {
		return err;
	}

	return 0;
}

bool link_is_paired(enum peer peer)
{
	return paired(&links[peer]);
}

void link_unpair(enum peer peer)
{
	struct link *l = &links[peer];
	bt_addr_le_t addr;

	k_mutex_lock(&lock, K_FOREVER);
	bt_addr_le_copy(&addr, &l->addr);
	bt_addr_le_copy(&l->addr, BT_ADDR_LE_ANY);
	save_addr(l);
	k_mutex_unlock(&lock);

	if (!bt_addr_le_eq(&addr, BT_ADDR_LE_ANY)) {
		bt_unpair(BT_ID_DEFAULT, &addr);
	}
}

int link_connect(enum peer peer, bool pair, link_adv_check_t check, k_timeout_t timeout)
{
	struct link *l = &links[peer];
	k_timepoint_t end = sys_timepoint_calc(timeout);
	int err;

	if (!pair && !paired(l)) {
		return -ENOENT;
	}

	k_mutex_lock(&lock, K_FOREVER);
	k_sem_reset(&l->done);
	l->pair = pair;
	l->check = check;
	l->connecting = true;
	scan_update();
	k_mutex_unlock(&lock);

	while (k_sem_take(&l->done, K_MSEC(POLL_MS)) != 0) {
		if (!atomic_get(&aborted) && !sys_timepoint_expired(end)) {
			continue;
		}

		k_mutex_lock(&lock, K_FOREVER);
		if (!l->connecting) {
			/* Finished just now */
			k_mutex_unlock(&lock);
			break;
		}
		l->connecting = false;
		scan_update();
		k_mutex_unlock(&lock);

		link_disconnect(peer);
		err = atomic_get(&aborted) ? -ECANCELED : -ETIMEDOUT;
		goto out;
	}

	err = l->err;

out:
	k_mutex_lock(&lock, K_FOREVER);
	if (l->addr_changed) {
		l->addr_changed = false;
		save_addr(l);
		if (!bt_addr_le_eq(&l->replaced, BT_ADDR_LE_ANY) &&
		    !bt_addr_le_eq(&l->replaced, &l->addr)) {
			bt_unpair(BT_ID_DEFAULT, &l->replaced);
		}
	}
	k_mutex_unlock(&lock);

	return err;
}

void link_disconnect(enum peer peer)
{
	struct link *l = &links[peer];
	struct bt_conn *conn;

	k_mutex_lock(&lock, K_FOREVER);
	if (!l->conn) {
		k_mutex_unlock(&lock);
		return;
	}
	k_sem_reset(&l->gone);
	conn = bt_conn_ref(l->conn);
	k_mutex_unlock(&lock);

	/* Also cancels a connection still being created */
	bt_conn_disconnect(conn, BT_HCI_ERR_REMOTE_USER_TERM_CONN);
	bt_conn_unref(conn);

	if (k_sem_take(&l->gone, K_SECONDS(10)) != 0) {
		LOG_ERR("%s: disconnect timed out", l->name);
	}
}

void link_abort(void)
{
	atomic_set(&aborted, 1);
}

void link_clear_abort(void)
{
	atomic_set(&aborted, 0);
}

int link_sleep(uint32_t ms)
{
	while (ms > 0 && !atomic_get(&aborted)) {
		uint32_t step = MIN(ms, POLL_MS);

		k_msleep(step);
		ms -= step;
	}
	return atomic_get(&aborted) ? -ECANCELED : 0;
}

/*
 * GATT procedures complete through their callback, an ATT timeout or a disconnect, so the
 * waits below need no timeout of their own.
 */
static int wait_done(struct link *l, int err)
{
	if (err) {
		return err;
	}
	k_sem_take(&l->done, K_FOREVER);
	return l->err;
}

static uint8_t discover_cb(struct bt_conn *conn, const struct bt_gatt_attr *attr,
			   struct bt_gatt_discover_params *params)
{
	struct link *l = CONTAINER_OF(params, struct link, discover);

	if (attr) {
		l->found = ((const struct bt_gatt_chrc *)attr->user_data)->value_handle;
		l->err = 0;
	} else {
		l->err = -ENOENT;
	}
	k_sem_give(&l->done);
	return BT_GATT_ITER_STOP;
}

int link_find(enum peer peer, const struct bt_uuid *uuid, uint16_t *handle)
{
	struct link *l = &links[peer];
	struct bt_conn *conn = get_conn(l);
	int err;

	if (!conn) {
		return -ENOTCONN;
	}

	l->discover = (struct bt_gatt_discover_params){
		.uuid = uuid,
		.func = discover_cb,
		.start_handle = BT_ATT_FIRST_ATTRIBUTE_HANDLE,
		.end_handle = BT_ATT_LAST_ATTRIBUTE_HANDLE,
		.type = BT_GATT_DISCOVER_CHARACTERISTIC,
	};
	k_sem_reset(&l->done);
	err = wait_done(l, bt_gatt_discover(conn, &l->discover));
	bt_conn_unref(conn);

	if (!err) {
		*handle = l->found;
	}
	return err;
}

static void write_cb(struct bt_conn *conn, uint8_t att_err, struct bt_gatt_write_params *params)
{
	struct link *l = CONTAINER_OF(params, struct link, write);

	l->err = att_err ? -EIO : 0;
	k_sem_give(&l->done);
}

int link_write(enum peer peer, uint16_t handle, const void *data, uint16_t len)
{
	struct link *l = &links[peer];
	struct bt_conn *conn = get_conn(l);
	int err;

	if (!conn) {
		return -ENOTCONN;
	}

	l->write = (struct bt_gatt_write_params){
		.func = write_cb,
		.handle = handle,
		.data = data,
		.length = len,
	};
	k_sem_reset(&l->done);
	err = wait_done(l, bt_gatt_write(conn, &l->write));
	bt_conn_unref(conn);
	return err;
}

static uint8_t read_cb(struct bt_conn *conn, uint8_t att_err, struct bt_gatt_read_params *params,
		       const void *data, uint16_t length)
{
	struct link *l = CONTAINER_OF(params, struct link, read);

	if (att_err) {
		l->err = -EIO;
	} else if (data) {
		l->err = MIN(length, l->read_size);
		memcpy(l->read_buf, data, l->err);
	} else {
		l->err = 0;
	}
	k_sem_give(&l->done);
	return BT_GATT_ITER_STOP;
}

int link_read(enum peer peer, uint16_t handle, void *buf, uint16_t size)
{
	struct link *l = &links[peer];
	struct bt_conn *conn = get_conn(l);
	int err;

	if (!conn) {
		return -ENOTCONN;
	}

	l->read_buf = buf;
	l->read_size = size;
	l->read = (struct bt_gatt_read_params){
		.func = read_cb,
		.handle_count = 1,
		.single.handle = handle,
	};
	k_sem_reset(&l->done);
	err = wait_done(l, bt_gatt_read(conn, &l->read));
	bt_conn_unref(conn);
	return err;
}

static uint8_t notify_cb(struct bt_conn *conn, struct bt_gatt_subscribe_params *params,
			 const void *data, uint16_t length)
{
	struct subscription *s = CONTAINER_OF(params, struct subscription, params);
	struct link *l = s->link;
	struct notification n;

	if (!data) {
		/* Unsubscribed, e.g. by the disconnect, which frees the slot */
		params->value_handle = 0;
		return BT_GATT_ITER_STOP;
	}

	n.len = MIN(length, sizeof(n.data));
	memcpy(n.data, data, n.len);
	if (k_msgq_put(&l->rx, &n, K_NO_WAIT) != 0) {
		LOG_WRN("%s: notification dropped", l->name);
	}
	return BT_GATT_ITER_CONTINUE;
}

static void subscribe_cb(struct bt_conn *conn, uint8_t att_err,
			 struct bt_gatt_subscribe_params *params)
{
	struct subscription *s = CONTAINER_OF(params, struct subscription, params);
	struct link *l = s->link;

	l->err = att_err ? -EIO : 0;
	k_sem_give(&l->done);
}

int link_subscribe(enum peer peer, uint16_t handle)
{
	struct link *l = &links[peer];
	struct subscription *s = NULL;
	struct bt_conn *conn;
	int err;

	ARRAY_FOR_EACH_PTR(l->subs, slot) {
		if (slot->params.value_handle == 0) {
			s = slot;
			break;
		}
	}
	if (!s) {
		return -ENOMEM;
	}

	conn = get_conn(l);
	if (!conn) {
		return -ENOTCONN;
	}

	s->link = l;
	s->params = (struct bt_gatt_subscribe_params){
		.notify = notify_cb,
		.subscribe = subscribe_cb,
		.value = BT_GATT_CCC_NOTIFY,
		.value_handle = handle,
		.ccc_handle = BT_GATT_AUTO_DISCOVER_CCC_HANDLE,
		.end_handle = BT_ATT_LAST_ATTRIBUTE_HANDLE,
		.disc_params = &s->discover,
	};
	/* Peers don't keep subscriptions across connections, so neither do we */
	atomic_set_bit(s->params.flags, BT_GATT_SUBSCRIBE_FLAG_VOLATILE);

	k_sem_reset(&l->done);
	err = wait_done(l, bt_gatt_subscribe(conn, &s->params));
	bt_conn_unref(conn);
	if (err) {
		s->params.value_handle = 0;
	}
	return err;
}

void link_flush(enum peer peer)
{
	k_msgq_purge(&links[peer].rx);
}

int link_recv(enum peer peer, void *buf, size_t size, k_timeout_t timeout)
{
	struct notification n;
	int err;

	err = k_msgq_get(&links[peer].rx, &n, timeout);
	if (err) {
		return err;
	}

	memcpy(buf, n.data, MIN(n.len, size));
	return MIN(n.len, size);
}

struct mfg_search {
	uint16_t company;
	uint8_t *buf;
	size_t size;
	int len;
};

static bool mfg_data_cb(struct bt_data *data, void *user_data)
{
	struct mfg_search *search = user_data;

	if (data->type != BT_DATA_MANUFACTURER_DATA || data->data_len < 2 ||
	    sys_get_le16(data->data) != search->company) {
		return true;
	}

	search->len = data->data_len - 2;
	memcpy(search->buf, &data->data[2], MIN(search->len, search->size));
	return false;
}

int link_mfg_data(struct net_buf_simple *ad, uint16_t company, uint8_t *buf, size_t size)
{
	struct mfg_search search = {
		.company = company,
		.buf = buf,
		.size = size,
		.len = -ENOENT,
	};

	bt_data_parse(ad, mfg_data_cb, &search);
	return search.len;
}
```

## src/link.h
```c
#ifndef LINK_H_
#define LINK_H_

#include <stdbool.h>
#include <stddef.h>
#include <stdint.h>

#include <zephyr/bluetooth/bluetooth.h>
#include <zephyr/bluetooth/uuid.h>
#include <zephyr/kernel.h>

/*
 * Connections to the remote devices. Each peer has at most one connection, so the blocking
 * calls below name the peer rather than the connection. Every peer has its own thread.
 */

enum peer {
	PEER_GOPRO,
	PEER_FLYSIGHT,
	PEER_COUNT,
};

/*
 * Looks at an advertisement from a candidate. Returns 0 to connect, a positive value to skip
 * this report and keep scanning, or a negative error to give up with that error.
 */
typedef int (*link_adv_check_t)(uint8_t adv_type, struct net_buf_simple *ad);

/* Load the peer roles saved by earlier pairings. Call after settings_load(). */
int link_init(void);

bool link_is_paired(enum peer peer);

/* Forget the bonded device. */
void link_unpair(enum peer peer);

/*
 * Scan until the peer advertises, connect, and encrypt the link with the bond keys. With pair
 * set, connect instead to any device that check accepts and bond with it as this peer. check
 * may be NULL when not pairing.
 */
int link_connect(enum peer peer, bool pair, link_adv_check_t check, k_timeout_t timeout);

void link_disconnect(enum peer peer);

/* Abandon waits for a connection and link_sleep() in every peer thread. */
void link_abort(void);

/* Re-arm the peer threads after link_abort(). */
void link_clear_abort(void);

/* Sleep that link_abort() cuts short with -ECANCELED. */
int link_sleep(uint32_t ms);

int link_find(enum peer peer, const struct bt_uuid *uuid, uint16_t *handle);
int link_write(enum peer peer, uint16_t handle, const void *data, uint16_t len);

/* Returns the number of bytes read. */
int link_read(enum peer peer, uint16_t handle, void *buf, uint16_t size);

/* Queue notifications from this characteristic for link_recv(). Up to two per connection. */
int link_subscribe(enum peer peer, uint16_t handle);

/* Drop queued notifications. */
void link_flush(enum peer peer);

/* Returns the length of the next queued notification, truncated to size. */
int link_recv(enum peer peer, void *buf, size_t size, k_timeout_t timeout);

/*
 * Find manufacturer specific data for a company in an advertisement. Returns the length of the
 * data after the company ID, copied to buf up to size, or -ENOENT.
 */
int link_mfg_data(struct net_buf_simple *ad, uint16_t company, uint8_t *buf, size_t size);

#endif /* LINK_H_ */
```

## src/shell.c
```c
/* Debug commands over the RTT shell, built only with debug.conf. */

#include <stdlib.h>
#include <string.h>

#include <zephyr/bluetooth/bluetooth.h>
#include <zephyr/shell/shell.h>
#include <zephyr/sys/byteorder.h>

#include "action.h"
#include "link.h"

static const char *const peer_names[] = {
	[PEER_GOPRO] = "gopro",
	[PEER_FLYSIGHT] = "flysight",
};

static int cmd_press(const struct shell *sh, size_t argc, char **argv)
{
	uint32_t held_ms = argc > 1 ? strtoul(argv[1], NULL, 10) : 100;

	button_press(held_ms);
	return 0;
}

static int cmd_long(const struct shell *sh, size_t argc, char **argv)
{
	button_press(2000);
	return 0;
}

static int cmd_pair(const struct shell *sh, size_t argc, char **argv)
{
	button_press(10000);
	return 0;
}

static int cmd_status(const struct shell *sh, size_t argc, char **argv)
{
	for (int i = 0; i < PEER_COUNT; i++) {
		shell_print(sh, "%s: %s", peer_names[i],
			    link_is_paired(i) ? "paired" : "not paired");
	}
	return 0;
}

static int cmd_unpair(const struct shell *sh, size_t argc, char **argv)
{
	for (int i = 0; i < PEER_COUNT; i++) {
		if (!strcmp(argv[1], "all") || !strcmp(argv[1], peer_names[i])) {
			link_unpair(i);
			shell_print(sh, "%s: unpaired", peer_names[i]);
		}
	}
	return 0;
}

#define SCAN_MAX 24

static bt_addr_le_t seen[SCAN_MAX];
static size_t seen_count;
static const struct shell *scan_shell;

struct ad_summary {
	char name[20];
	int company;
	bool gopro_uuid;
};

static bool summarize(struct bt_data *data, void *user_data)
{
	struct ad_summary *sum = user_data;

	switch (data->type) {
	case BT_DATA_NAME_COMPLETE:
	case BT_DATA_NAME_SHORTENED:
		memcpy(sum->name, data->data, MIN(data->data_len, sizeof(sum->name) - 1));
		break;
	case BT_DATA_MANUFACTURER_DATA:
		if (data->data_len >= 2) {
			sum->company = sys_get_le16(data->data);
		}
		break;
	case BT_DATA_UUID16_SOME:
	case BT_DATA_UUID16_ALL:
		for (size_t i = 0; i + 1 < data->data_len; i += 2) {
			sum->gopro_uuid |= sys_get_le16(&data->data[i]) == 0xfea6;
		}
		break;
	}
	return true;
}

static void scan_recv(const struct bt_le_scan_recv_info *info, struct net_buf_simple *buf)
{
	struct ad_summary sum = {.company = -1};
	char addr[BT_ADDR_LE_STR_LEN];

	if (!scan_shell) {
		return;
	}
	for (size_t i = 0; i < seen_count; i++) {
		if (bt_addr_le_eq(&seen[i], info->addr)) {
			return;
		}
	}
	if (seen_count < SCAN_MAX) {
		bt_addr_le_copy(&seen[seen_count++], info->addr);
	}

	bt_data_parse(buf, summarize, &sum);
	bt_addr_le_to_str(info->addr, addr, sizeof(addr));
	shell_print(scan_shell, "%s rssi %d type %u props 0x%02x company %04x%s %s", addr,
		    info->rssi, info->adv_type, info->adv_props, sum.company & 0xffff,
		    sum.gopro_uuid ? " FEA6" : "", sum.name);
}

static struct bt_le_scan_cb scan_callbacks = {
	.recv = scan_recv,
};

static int cmd_scan(const struct shell *sh, size_t argc, char **argv)
{
	static bool registered;
	uint32_t seconds = argc > 1 ? strtoul(argv[1], NULL, 10) : 10;
	int err;

	if (!registered) {
		bt_le_scan_cb_register(&scan_callbacks);
		registered = true;
	}

	seen_count = 0;
	scan_shell = sh;
	err = bt_le_scan_start(BT_LE_SCAN_ACTIVE, NULL);
	if (err) {
		shell_error(sh, "Scan failed to start (%d)", err);
		scan_shell = NULL;
		return err;
	}

	k_sleep(K_SECONDS(seconds));
	bt_le_scan_stop();
	scan_shell = NULL;
	shell_print(sh, "%u devices", seen_count);
	return 0;
}

SHELL_STATIC_SUBCMD_SET_CREATE(gl_cmds,
	SHELL_CMD_ARG(scan, NULL, "[seconds] List advertisers; only while idle", cmd_scan, 1, 1),
	SHELL_CMD_ARG(press, NULL, "Short press, or [held_ms] for any length", cmd_press, 1, 1),
	SHELL_CMD(long, NULL, "Long press: stop", cmd_long),
	SHELL_CMD(pair, NULL, "10 s hold: pairing mode", cmd_pair),
	SHELL_CMD(status, NULL, "Show which devices are paired", cmd_status),
	SHELL_CMD_ARG(unpair, NULL, "<gopro|flysight|all>", cmd_unpair, 2, 0),
	SHELL_SUBCMD_SET_END);

SHELL_CMD_REGISTER(gl, &gl_cmds, "Greenlight button", NULL);
```
