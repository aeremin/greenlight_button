## boards/radioland/radioland_beacon/board.yml
```yaml
board:
  name: radioland_beacon
  full_name: Radioland nRF52832 coin-cell beacon
  socs:
    - name: nrf52832
```

## manifest/west.yml
```yaml
manifest:
  remotes:
    - name: zephyrproject-rtos
      url-base: https://github.com/zephyrproject-rtos
  projects:
    - name: zephyr
      remote: zephyrproject-rtos
      revision: v4.4.2
      path: zephyr
      import:
        path-prefix: third_party
        # Only the modules an nRF52832 needs; drop this list to get everything.
        name-allowlist:
          - cmsis
          - cmsis_6
          - hal_nordic
          # PSA crypto for Bluetooth pairing
          - mbedtls
          - tf-psa-crypto
          - segger
```
